## boards/shields/bme280_shield/Kconfig.defconfig
```kconfig
if SHIELD_BME280_SHIELD

config I2C
	default y

config SENSOR
	default y

config BME280
	default y

endif # SHIELD_BME280_SHIELD
```

## boards/shields/ws2812_shield/Kconfig.defconfig
```kconfig
if SHIELD_WS2812_SHIELD

config I2S
	default y

config LED_STRIP
	default y

config WS2812_STRIP_I2S
	default y

endif # SHIELD_WS2812_SHIELD
```

## boards/shields/ws2812_shield/Kconfig.shield
```kconfig
config SHIELD_WS2812_SHIELD
	def_bool $(shields_list_contains,ws2812_shield)
	depends on BOARD_NRF52840DK_NRF52840 || BOARD_NRF5340DK_NRF5340_CPUAPP
```
